## CMakeLists.txt
```
# SPDX-License-Identifier: Apache-2.0

cmake_minimum_required(VERSION 3.20.0)
find_package(Zephyr REQUIRED HINTS $ENV{ZEPHYR_BASE})
project(telemetry-sample)

zephyr_library_link_libraries(thingsboard)

target_sources(app PRIVATE src/main.c)

target_compile_options(app PRIVATE
    -Wall
    -Werror
    -Wno-unused-parameter
)
```

## prj.conf
```kconfig
CONFIG_LOG=y
CONFIG_SHELL=y
CONFIG_SHELL_MINIMAL=y

# Cellular connectivity
CONFIG_NRF_MODEM_LIB=y
CONFIG_NRF_MODEM_LIB_LOG_FW_VERSION_UUID=y
CONFIG_LTE_LINK_CONTROL=y
CONFIG_LTE_NETWORK_MODE_LTE_M_NBIOT=y
CONFIG_LTE_MODE_PREFERENCE_LTE_M=y
CONFIG_LTE_PSM_REQ=y
CONFIG_LTE_EDRX_REQ=y
CONFIG_NET_SOCKETS_OFFLOAD=y

# Requirements for Thingsboard SDK
CONFIG_COAP=y
CONFIG_COAP_CLIENT=y
CONFIG_NETWORKING=y
CONFIG_NET_IPV4=y
CONFIG_NET_SOCKETS=y
CONFIG_JSON_LIBRARY=y
CONFIG_FLASH=y
CONFIG_FLASH_MAP=y
CONFIG_NVS=y
CONFIG_SETTINGS=y

# CoAP Client configuration
CONFIG_COAP_CLIENT_BLOCK_SIZE=1024
CONFIG_COAP_CLIENT_THREAD_PRIORITY=5
CONFIG_COAP_CLIENT_STACK_SIZE=2048
CONFIG_COAP_CLIENT_MAX_REQUESTS=4

# Thingsboard SDK
CONFIG_THINGSBOARD=y
CONFIG_THINGSBOARD_USE_PROVISIONING=n

# Set server name and access token
# CONFIG_THINGSBOARD_SERVER_HOSTNAME=""
# CONFIG_THINGSBOARD_ACCESS_TOKEN=""
```

## src/main.c
```c
#include <thingsboard.h>

#include <modem/lte_lc.h>
#include <modem/nrf_modem_lib.h>
#include <zephyr/kernel.h>
#include <zephyr/logging/log.h>
#include <zephyr/settings/settings.h>
#include <zephyr/shell/shell.h>

#include <string.h>

LOG_MODULE_REGISTER(main);

static struct thingsboard_configuration tb_cfg = {
	.current_firmware = {.title = "telemetry-sample", .version = "v1.0.0"},

	.device_name = "sample-device",

	.server_hostname = CONFIG_THINGSBOARD_SERVER_HOSTNAME,
	.server_port = CONFIG_THINGSBOARD_SERVER_PORT,
};

int main(void)
{
	int err = 0;

	LOG_INF("Initializing modem library");
	err = nrf_modem_lib_init();
	if (err) {
		LOG_ERR("Failed to initialize the modem library, error (%d): %s", err,
			strerror(-err));
		return err;
	}

	err = lte_lc_func_mode_set(LTE_LC_FUNC_MODE_ACTIVATE_LTE);
	if (err) {
		LOG_ERR("Failed to activate LTE");
		return err;
	}

	LOG_INF("Connecting to LTE network");
	err = lte_lc_connect();
	if (err) {
		LOG_ERR("Could not establish LTE connection, error (%d): %s", err, strerror(-err));
		return err;
	}
	LOG_INF("LTE connection established");

	LOG_INF("Connecting to Thingsboards");
	err = thingsboard_init(&tb_cfg);
	if (err) {
		LOG_ERR("Could not initialize thingsboard connection, error (%d) :%s", err,
			strerror(-err));
		return err;
	}
}

static int cmd_send_uptime(const struct shell *shell, size_t argc, char **argv)
{
	int err;
	char payload[32];
	int64_t uptime = k_uptime_seconds();

	err = snprintk(payload, sizeof(payload), "{\"uptime\":%lld}", uptime);
	if (err < 0) {
		LOG_ERR("Could not format payload, error (%d): %s", err, strerror(-err));
		return err;
	}

	err = thingsboard_send_telemetry_buf(payload, strlen(payload));
	if (err) {
		LOG_ERR("Could not send telemetry, error (%d): %s", err, strerror(-err));
		return err;
	}

	return 0;
}

SHELL_CMD_REGISTER(send_uptime, NULL,
		   "Send the current up-time of the device as telemetry to the cloud",
		   cmd_send_uptime);
```
