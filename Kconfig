## Kconfig
```kconfig
menuconfig THINGSBOARD
    bool "Thingsboard library"
    depends on NETWORKING
    depends on NET_IPV4
    depends on NET_SOCKETS
    depends on JSON_LIBRARY
    depends on COAP
    depends on COAP_CLIENT

if THINGSBOARD

config THINGSBOARD_FOTA
    bool "Thingsboard FOTA support"
    depends on DFU_TARGET_MCUBOOT
    default y if DFU_TARGET_MCUBOOT

config APP_MCUBOOT_FLASH_BUF_SZ
    int "Size of buffer used for flash write operations during MCUboot updates"
    depends on DFU_TARGET_MCUBOOT
    default 4096
    help
      Buffer size must be aligned to the minimal flash write block size.

config THINGSBOARD_USE_PROVISIONING
    bool "Provision devices"
    depends on SETTINGS
    depends on FLASH
    depends on FLASH_MAP
    depends on NVS
    depends on !THINGSBOARD_DTLS
    default y

if THINGSBOARD_USE_PROVISIONING

config THINGSBOARD_PROVISIONING_KEY
    string "Provisioning key"

config THINGSBOARD_PROVISIONING_SECRET
    string "Provisioning secret"

endif # THINGSBOARD_USE_PROVISIONING

config THINGSBOARD_ACCESS_TOKEN
  string
  prompt "Device Access Token" if !THINGSBOARD_USE_PROVISIONING
  default ""

config THINGSBOARD_TIME
    bool "Time Synchronization"
    default y
    help
      Use the RPC mechanism to request time from thingsboard instance.
      For this to work, the serverside RPC function `getCurrentTime` must be
      implemented.

if THINGSBOARD_TIME

config THINGSBOARD_TIME_REFRESH_INTERVAL_SECONDS
    int "Interval in seconds between time refresh"
    default 3600

endif # THINGSBOARD_TIME

config THINGSBOARD_MAX_STRINGS_LENGTH
    int "Max strings length"
    default 24
    help
      Maximum length of strings such as `fw_title` and `fw_version`.

config THINGSBOARD_REQUEST_MAX_PATH_LENGTH
    int "May path length per request"
    default 24 if THINGSBOARD_DTLS
    default 48

config THINGSBOARD_MAX_TELEMETRY_PER_MESSAGE
    int "Max count of telemetries per message"
    default 16

choice THINGSBOARD_CONTENT_FORMAT
    bool "Content format"
    default THINGSBOARD_CONTENT_FORMAT_JSON

config THINGSBOARD_CONTENT_FORMAT_JSON
    bool "JSON"
    depends on JSON_LIBRARY

config THINGSBOARD_CONTENT_FORMAT_PROTOBUF
    bool "Protobuf"
    depends on NANOPB

endchoice # THINGSBOARD_CONTENT_FORMAT

if THINGSBOARD_CONTENT_FORMAT_PROTOBUF

config THINGSBOARD_PROTOBUF_CUSTOM_PROTO_FILE
    bool "Use custom protobuf schema file"
    default n
    help
      Application provides its own protobuf schema.

      The application is expected to call `thingsboard_set_protofile()` in its
      CMakeLists.txt file.

config THINGSBOARD_PROTOBUF_ATTRIBUTES_WORKAROUND_DEFAULT
    bool "Protobuf attributes parsing workaround"
    default y
    help
      Thingsboard seems to ignore the given protobuf schema for attributes
      downstream messages and instead returns an internal protobuf object of
      type `AttributeUpdateNotificationMsg`. This option makes the
      Thinksboard SDK parse attribute downstream messages always as to be in
      this format.

endif # THINGSBOARD_CONTENT_FORMAT_PROTOBUF

config THINGSBOARD_DTLS
    bool "Use DTLS"
    default n
    help
      Enables the use of DTLS. The thingsboard SDK expects to be given
      security tags by the application. These tags should contain the used CA
      certificate, as well as the client certificate and key. Only certificate
      authentication is supported.

choice THINGSBOARD_SOCKET_SUSPEND
    bool "Socket suspend mechanism"
    default THINGSBOARD_SOCKET_SUSPEND_NONE

config THINGSBOARD_SOCKET_SUSPEND_NONE
    bool "None"
    help
      Do nothing

config THINGSBOARD_SOCKET_SUSPEND_DISCONNECT
    bool "Disconnect"
    help
      Disconnect socket, create and connect a new one on resume

config THINGSBOARD_SOCKET_SUSPEND_RAI
    bool "RAI"
    help
      Set the socket option SO_RAI to RAI_NO_DATA. On resume SO_RAI is set
      to RAI_ONGOING.

endchoice # THINGSBOARD_SOCKET_SUSPEND

config THINGSBOARD_TELEMETRY_ALWAYS_TIMESTAMP
    bool "Always send timestamp with telemetry"
    default y
    depends on THINGSBOARD_TIME
    help
      When enabled, thingsboard always adds timestamp to telemetry data.

config THINGSBOARD_CONNECT_ON_INIT
    bool "Connect to Thingsboard init"
    default y

module = THINGSBOARD
module-str = Thingsboard SDK
source "subsys/logging/Kconfig.template.log_config"

endif # THINGSBOARD
```

## tests/compile/testcase.yaml
```yaml
common:
  platform_allow:
    - qemu_cortex_m0
    - native_sim
tests:
  thingsboard.compile:
    extra_configs:
      - CONFIG_THINGSBOARD_TIME_REFRESH_INTERVAL_SECONDS=5
  thingsboard.failure:
    extra_configs:
      - CONFIG_THINGSBOARD_TEST_FAILURE=y
  thingsboard.compile_provisioning:
    build_only: true
    extra_configs:
      - CONFIG_THINGSBOARD_USE_PROVISIONING=y
      - CONFIG_SETTINGS=y
      - CONFIG_FLASH=y
      - CONFIG_FLASH_MAP=y
      - CONFIG_NVS=y
  thingsboard.compile_fota:
    build_only: true
    extra_configs:
      - CONFIG_THINGSBOARD_FOTA=y
      - CONFIG_DFU_TARGET_MCUBOOT=y
```

## west.yml
```yaml
manifest:
  defaults:
    remote: github

  remotes:
    - name: github
      url-base: https://github.com

  projects:
    - name: nrf
      remote: github
      repo-path: nrfconnect/sdk-nrf
      revision: v3.0.0-rc1
      path: nrf
      import:
        name-allowlist:
          - cmsis
          - hal_nordic
          - libmodem
          - mbedtls
          - mcuboot
          - nanopb
          - nrfxlib
          - oberon-psa-crypto
          - picolibc
          - trusted-firmware-m
          - zephyr

  self:
    path: modules/thingsboard
```
